// This is an example for Teensy 3.2 with one encoder connected as follows:
//   Pin  2 / PTD0 to Quadrature signal A
//   Pin 14 / PTD1 to Quadrature signal B
//   Pin  6 / PTD4 to Data signal Q

// Number of decoders to implement (up to 16)
#define QUADRATURE_COUNT 1

// Any fast method of obtaining the input data
// Each encoder is a pair of bits 0-1, 2-3, etc. where odd bits are A, even bits B
#define QUADRATURE_BITS (GPIOD_PDIR) // Lands in variable "qbit" when read
#define QUADRATURE_DATA (qbit >> 4)  // May use variable "qbit"

// Data lookup table
const uint8_t quadrature_lut[] = {
  0xF9, 0xFA, 0xFB, 0x13, 0xFC, 0x2C, 0x14, 0xC0, 0xFD, 0xD9, 0x2D, 0xE8, 0x15, 0x62, 0xC1, 0x45,
  0x5E, 0xFE, 0x08, 0xDA, 0x87, 0x2E, 0x7B, 0xE9, 0xBB, 0x16, 0xF2, 0x63, 0x02, 0xC2, 0x6B, 0x46,
  0x29, 0x5F, 0x84, 0xFF, 0x1B, 0x09, 0x1E, 0xDB, 0xD4, 0x88, 0x8D, 0x2F, 0x3F, 0x7C, 0x0C, 0xEA,
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  0xE4, 0xEE, 0xD0, 0x6E, 0xA9, 0x52, 0x4A, 0xA2, 0xE3, 0xCF, 0xA8, 0x49, 0xE2, 0xA7, 0xE1, 0xE0
};

#define __INLINE __attribute__((always_inline)) inline

// Interrupt timer, Teensy style
IntervalTimer pit;

// Current quadrature count
int32_t quadrature_count[QUADRATURE_COUNT];

// Current quadrature state
// 16 MSB: Current direction
// 16 LSB: Position has been found
uint32_t quadrature_state;

// Parallel quadrature decoder with LFSR-based position finder
__attribute__((optimize("unroll-loops")))
static __INLINE
void decode_quadratures() {
  
  // Static locals
  bool static frun = true;
  uint32_t static qwas;
  struct {
    uint32_t data;
    int16_t lo, hi;
  } static qaux[QUADRATURE_COUNT] = {0, };
  
  // Locals
  uint32_t qbit = QUADRATURE_BITS;
  uint16_t data = QUADRATURE_DATA;
  
  if(frun && !(frun = false)) {
      
      // Initialize
      qwas = qbit;
      for(int id = 0; id < QUADRATURE_COUNT; id++) qaux[id].hi = -(qaux[id].lo = 1);
      
  } else {
      
      // Signal processing
      uint32_t xora = (qbit ^ (qwas >> 1)) & 0x55555555;
      uint32_t xorb = (qwas ^ (qbit >> 1)) & 0x55555555;
      uint32_t decoded = ((xora ^ xorb) << 1) | xora;
      uint32_t state = quadrature_state;
      for(int id = 0; id < QUADRATURE_COUNT; id++, decoded >>= 2) {
        if(decoded & 2) {
          if(!(decoded & 1) == !(state & (1 << (16 + id)))) {
              int32_t count = quadrature_count[id] + ((decoded & 1) ? -1 : +1);
              if(!(state & (1 << id))) {
                qaux[id].data |= ((data >> id) & 1) << (16 - count);
                if(count > qaux[id].hi) qaux[id].hi = count;
                if(count < qaux[id].lo) qaux[id].lo = count;
                if(2 << (qaux[id].hi - qaux[id].lo) == sizeof(quadrature_lut)) {
                  state |= (1 << id);
                  count = quadrature_lut[qaux[id].data >> 16 - qaux[id].hi] + count - qaux[id].lo + !(decoded & 1);
                }
              }
              quadrature_count[id] = count;
          } else {
              state ^= (1 << (16 + id));
          }
        }
      }
      quadrature_state = state;
      qwas = qbit;

  }
}

// Quadrature polling interrupt
void my_interrupt() {
  GPIOE_PSOR = 1 << 30; // Enables CPU use measurement by Oscilloscope
  decode_quadratures();
  GPIOE_PCOR = 1 << 30;
}

// System setup
void setup() {
  pinMode(26, OUTPUT);       // PTE1 = CPU usage
  pinMode( 2, INPUT_PULLUP); // PTD0 = A
  pinMode(14, INPUT_PULLUP); // PTD1 = B
  pinMode( 6, INPUT_PULLUP); // PTD4 = Q
  
  // Launch periodic interrupt at 100kHz
  pit.begin(my_interrupt, 10);

  // Enable serial output via USB
  Serial.begin(115200);
}

// Periodically print state to USB serial port
void loop() {
  delay(100);
  Serial.printf("%u %02X\n", quadrature_state & 1, quadrature_count[0] & 255);
}
